## CMakeLists.txt
```
cmake_minimum_required(VERSION 3.20.0)

find_package(Zephyr REQUIRED HINTS $ENV{ZEPHYR_BASE})
project(NONE)

target_sources(app PRIVATE
	src/main.c
	src/model_handler.c
	src/soil_cli.c)
target_include_directories(app PRIVATE include)
```

## prj.conf
```kconfig
#
# Copyright (c) 2019 Nordic Semiconductor ASA
#
# SPDX-License-Identifier: LicenseRef-Nordic-5-Clause
#
CONFIG_NCS_SAMPLES_DEFAULTS=y

# Deffered logging helps improve LPN power consumption
# when friendship is established.
CONFIG_LOG_MODE_DEFERRED=y

# General configuration
CONFIG_SYSTEM_WORKQUEUE_STACK_SIZE=2048
CONFIG_FLASH=y
CONFIG_FLASH_MAP=y
CONFIG_NVS=y
CONFIG_SETTINGS=y
CONFIG_HWINFO=y
CONFIG_DK_LIBRARY=y
CONFIG_PM_SINGLE_IMAGE=y
CONFIG_PM_PARTITION_SIZE_SETTINGS_STORAGE=0x8000
CONFIG_SOC_FLASH_NRF_PARTIAL_ERASE=y

# Bluetooth configuration
CONFIG_BT=y
CONFIG_BT_COMPANY_ID=0x0059
CONFIG_BT_DEVICE_NAME="Mesh Soil Relay"
CONFIG_BT_L2CAP_TX_MTU=69
CONFIG_BT_L2CAP_TX_BUF_COUNT=8
CONFIG_BT_OBSERVER=y
CONFIG_BT_PERIPHERAL=y
CONFIG_BT_SETTINGS=y
CONFIG_BT_RX_STACK_SIZE=4096

CONFIG_MAIN_STACK_SIZE=4096

# Disable unused Bluetooth features
CONFIG_BT_CTLR_DUP_FILTER_LEN=0
CONFIG_BT_CTLR_LE_ENC=n
CONFIG_BT_DATA_LEN_UPDATE=n
CONFIG_BT_PHY_UPDATE=n
CONFIG_BT_CTLR_CHAN_SEL_2=n
CONFIG_BT_CTLR_MIN_USED_CHAN=n
CONFIG_BT_CTLR_PRIVACY=n

# Bluetooth mesh configuration
CONFIG_BT_MESH=y
CONFIG_BT_MESH_RELAY=y
CONFIG_BT_MESH_FRIEND=y
CONFIG_BT_MESH_ADV_BUF_COUNT=13
CONFIG_BT_MESH_TX_SEG_MAX=10
CONFIG_BT_MESH_PB_GATT=y
CONFIG_BT_MESH_GATT_PROXY=y
CONFIG_BT_MESH_PROXY_USE_DEVICE_NAME=y
CONFIG_BT_MESH_DK_PROV=y
CONFIG_BT_MESH_TX_SEG_MSG_COUNT=3

CONFIG_BT_MESH_ADV_BUF_COUNT=10
CONFIG_BT_MESH_RX_SEG_MAX=32
CONFIG_BT_MESH_MODEL_GROUP_COUNT=2
CONFIG_BT_MESH_LABEL_COUNT=0
CONFIG_BT_MESH_RELAY_RETRANSMIT_COUNT=3

# Bluetooth mesh models
CONFIG_BT_MESH_SENSOR_CLI=y

CONFIG_BT_MESH_PROVISIONER=y
CONFIG_BT_MESH_PROV_DEVICE=n
CONFIG_BT_MESH_CDB=y
CONFIG_BT_MESH_CDB_NODE_COUNT=16
CONFIG_BT_MESH_CDB_SUBNET_COUNT=3
CONFIG_BT_MESH_CDB_APP_KEY_COUNT=3

CONFIG_BT_MESH_CFG_CLI=y
CONFIG_BT_MESH_HEALTH_CLI=y
CONFIG_BT_MESH_BEACON_ENABLED=n

CONFIG_BT_BROADCASTER=y
```

## src/main.c
```c
#include <zephyr/bluetooth/bluetooth.h>
#include <bluetooth/mesh/models.h>
#include <bluetooth/mesh/dk_prov.h>
#include <dk_buttons_and_leds.h>
#include "model_handler.h"
#include "soil_cli.h"
#include "soil.h"

#define GROUP_ADDR 0xc000

static const uint16_t net_idx;
static const uint16_t app_idx;
static uint16_t self_addr = 1, node_addr;
static const uint8_t dev_uuid[16] = { 0xdd, 0xdd };
static uint8_t node_uuid[16];

K_SEM_DEFINE(sem_unprov_beacon, 0, 1);
K_SEM_DEFINE(sem_node_added, 0, 1);

static void setup_cdb(void)
{
	struct bt_mesh_cdb_app_key *key;

	key = bt_mesh_cdb_app_key_alloc(net_idx, app_idx);
	if (key == NULL) {
		printk("Failed to allocate app-key 0x%04x\n", app_idx);
		return;
	}

	bt_rand(key->keys[0].app_key, 16);

	if (IS_ENABLED(CONFIG_BT_SETTINGS)) {
		bt_mesh_cdb_app_key_store(key);
	}
}

static void configure_self(struct bt_mesh_cdb_node *self)
{
	struct bt_mesh_cdb_app_key *key;
	uint8_t status = 0;
	int err;

	printk("Configuring self...\n");

	key = bt_mesh_cdb_app_key_get(app_idx);
	if (key == NULL) {
		printk("No app-key 0x%04x\n", app_idx);
		return;
	}

	/* Add Application Key */
	err = bt_mesh_cfg_cli_app_key_add(self->net_idx, self->addr, self->net_idx, app_idx, key->keys[0].app_key, &status);
	if (err || status) {
		printk("Failed to add app-key (err %d, status %d)\n", err,
		       status);
		return;
	}

	err = bt_mesh_cfg_cli_mod_app_bind(self->net_idx, self->addr, self->addr, app_idx, BT_MESH_MODEL_ID_HEALTH_CLI, &status);
	if (err || status) {
		printk("Failed to bind app-key (err %d, status %d)\n", err, status);
		// return;
	}

	err = bt_mesh_cfg_cli_mod_app_bind_vnd(self->net_idx, self->addr, self->addr, app_idx, SOIL_CLI_MODEL_ID, CONFIG_BT_COMPANY_ID, &status);
	if (err || status) {
		printk("Failed to bind app-key (err %d, status %d)\n", err, status);
		// return;
	}

	err = bt_mesh_cfg_cli_mod_sub_add_vnd(self->net_idx, self->addr, self->addr, GROUP_ADDR, SOIL_CLI_MODEL_ID, CONFIG_BT_COMPANY_ID, &status);
	if (err || status) {
		printk("Failed Subscribe (err: %d, status: %d)\n", err, status);
		// return;
	}

	atomic_set_bit(self->flags, BT_MESH_CDB_NODE_CONFIGURED);

	if (IS_ENABLED(CONFIG_BT_SETTINGS)) {
		bt_mesh_cdb_node_store(self);
	}

	printk("Configuration complete\n");
}


static void configure_node(struct bt_mesh_cdb_node *node)
{
	NET_BUF_SIMPLE_DEFINE(buf, BT_MESH_RX_SDU_MAX);
	struct bt_mesh_comp_p0_elem elem;
	struct bt_mesh_cdb_app_key *key;
	struct bt_mesh_comp_p0 comp;
	uint8_t status;
	int err, elem_addr;

	printk("Configuring node 0x%04x...\n", node->addr);

	key = bt_mesh_cdb_app_key_get(app_idx);
	if (key == NULL) {
		printk("No app-key 0x%04x\n", app_idx);
		return;
	}

	/* Add Application Key */
	err = bt_mesh_cfg_cli_app_key_add(net_idx, node->addr, net_idx, app_idx, key->keys[0].app_key, &status);
	if (err || status) {
		printk("Failed to add app-key (err %d status %d)\n", err, status);
		return;
	}

	/* Get the node's composition data and bind all models to the appkey */
	err = bt_mesh_cfg_cli_comp_data_get(net_idx, node->addr, 0, &status, &buf);
	if (err || status) {
		printk("Failed to get Composition data (err %d, status: %d)\n", err, status);
		return;
	}

	err = bt_mesh_comp_p0_get(&comp, &buf);
	if (err) {
		printk("Unable to parse composition data (err: %d)\n", err);
		return;
	}

	elem_addr = node->addr;
	while (bt_mesh_comp_p0_elem_pull(&comp, &elem)) {
		printk("Element @ 0x%04x: %u + %u models\n", elem_addr, elem.nsig, elem.nvnd);
		for (int i = 0; i < elem.nsig; i++) {
			uint16_t id = bt_mesh_comp_p0_elem_mod(&elem, i);

			if (id == BT_MESH_MODEL_ID_CFG_CLI ||
			    id == BT_MESH_MODEL_ID_CFG_SRV) {
				continue;
			}
			printk("Binding AppKey to model 0x%03x:%04x\n", elem_addr, id);

			err = bt_mesh_cfg_cli_mod_app_bind(net_idx, node->addr, elem_addr, app_idx, id, &status);
			if (err || status) {
				printk("Failed (err: %d, status: %d)\n", err,
					status);
			}
		}

		for (int i = 0; i < elem.nvnd; i++) {
			struct bt_mesh_mod_id_vnd id = bt_mesh_comp_p0_elem_mod_vnd(&elem, i);

			printk("Binding AppKey to model 0x%03x:%04x:%04x\n", elem_addr, id.company, id.id);

			err = bt_mesh_cfg_cli_mod_app_bind_vnd(net_idx, node->addr, elem_addr, app_idx, id.id, id.company, &status);
			if (err || status) {
				printk("Failed (err: %d, status: %d)\n", err, status);
			}

			printk("Setting Publication and subscription for Sensor Server\n");
			struct bt_mesh_cfg_cli_mod_pub pub = {
				.addr = GROUP_ADDR,
				.uuid = NULL,
				.app_idx = app_idx,
				.cred_flag = false,
				.ttl = 5,
				.period = BT_MESH_PUB_PERIOD_10SEC(1),
				.transmit = BT_MESH_TRANSMIT(0, 100)
			};
			err = bt_mesh_cfg_cli_mod_pub_set_vnd(net_idx, node->addr, elem_addr, id.id, id.company, &pub, &status);
			if (err || status) {
				printk("Failed Publication Set (err: %d, status: %d)\n", err,
					status);
			}

			err = bt_mesh_cfg_cli_mod_sub_add_vnd(net_idx, node->addr, elem_addr, GROUP_ADDR, id.id, id.company, &status);
			if (err || status) {
				printk("Failed Subscribe (err: %d, status: %d)\n", err,
					status);
			}
		}

		elem_addr++;
	}

	atomic_set_bit(node->flags, BT_MESH_CDB_NODE_CONFIGURED);

	if (IS_ENABLED(CONFIG_BT_SETTINGS)) {
		bt_mesh_cdb_node_store(node);
	}

	printk("Configuration complete\n");
}

static void unprovisioned_beacon(uint8_t uuid[16],
				 bt_mesh_prov_oob_info_t oob_info,
				 uint32_t *uri_hash)
{
	memcpy(node_uuid, uuid, 16);
	k_sem_give(&sem_unprov_beacon);
}

static void node_added(uint16_t net_idx, uint8_t uuid[16], uint16_t addr, uint8_t num_elem)
{
	node_addr = addr;
	k_sem_give(&sem_node_added);
}

static const struct bt_mesh_prov prov = {
	.uuid = dev_uuid,
	.unprovisioned_beacon = unprovisioned_beacon,
	.node_added = node_added,
};

static uint8_t check_unconfigured(struct bt_mesh_cdb_node *node, void *data)
{
	if (!atomic_test_bit(node->flags, BT_MESH_CDB_NODE_CONFIGURED)) {
		if (node->addr == self_addr) {
			configure_self(node);
		} else {
			// printk("Configure node\n");
			configure_node(node);
		}
	}

	return BT_MESH_CDB_ITER_CONTINUE;
}

static int bt_ready(void)
{
	uint8_t net_key[16], dev_key[16];
	int err;

	dk_leds_init();
	dk_buttons_init(NULL);

	// err = bt_mesh_init(&prov, model_handler_init());
	err = bt_mesh_init(&prov, model_handler_init());
	if (err) {
		printk("Initializing mesh failed (err %d)\n", err);
		return err;
	}

	if (IS_ENABLED(CONFIG_SETTINGS)) {
		settings_load();
	}

	bt_rand(net_key, 16);

	err = bt_mesh_cdb_create(net_key);
	if (err == -EALREADY) {
		printk("Using stored CDB\n");
	} else if (err) {
		printk("Failed to create CDB (err %d)\n", err);
		return err;
	} else {
		printk("Created CDB\n");
		setup_cdb();
	}

	bt_rand(dev_key, 16);

	err = bt_mesh_provision(net_key, BT_MESH_NET_PRIMARY, 0, 0, self_addr, dev_key);
	if (err == -EALREADY) {
		printk("Using stored settings\n");
	} else if (err) {
		printk("Provisioning failed (err %d)\n", err);
		return err;
	} else {
		printk("Provisioning completed\n");
	}

	printk("Mesh initialized\n");

	return 0;
}

void main(void)
{
	char uuid_hex_str[32 + 1];

	int err;

	printk("Initializing...\n");

	err = bt_enable(NULL);
	if (err) {
		printk("Bluetooth init failed (err %d)\n", err);
	}

	printk("Bluetooth initialized\n");
	bt_ready();

	while (1) {
		k_sem_reset(&sem_unprov_beacon);
		k_sem_reset(&sem_node_added);
		bt_mesh_cdb_node_foreach(check_unconfigured, NULL);

		printk("Waiting for unprovisioned beacon...\n");
		err = k_sem_take(&sem_unprov_beacon, K_SECONDS(10));
		if (err == -EAGAIN) {
			continue;
		}

		bin2hex(node_uuid, 16, uuid_hex_str, sizeof(uuid_hex_str));

		printk("Provisioning %s\n", uuid_hex_str);
		err = bt_mesh_provision_adv(node_uuid, net_idx, 0, 0);
		if (err < 0) {
			printk("Provisioning failed (err %d)\n", err);
			continue;
		}

		printk("Waiting for node to be added...\n");
		err = k_sem_take(&sem_node_added, K_SECONDS(10));
		if (err == -EAGAIN) {
			printk("Timeout waiting for node to be added\n");
			continue;
		}

		printk("Added node 0x%04x\n", node_addr);
	}
}
```

## include/soil.h
```c
#ifndef BT_MESH_SOIL_H__
#define BT_MESH_SOIL_H__

#include <zephyr/bluetooth/mesh.h>
#include <bluetooth/mesh/model_types.h>

#define SOIL_CLI_MODEL_ID 0x0011
#define SOIL_SRV_MODEL_ID 0x0012

/** Soil set message parameters.  */
struct bt_mesh_soil_report {
	uint16_t humidity;
    uint8_t temperature;
};

#define BT_MESH_SOIL_OP_SOIL_REPORT BT_MESH_MODEL_OP_3(0x11, CONFIG_BT_COMPANY_ID)

#endif /* BT_MESH_SOIL_H__ */
```

## include/soil_cli.h
```c
#ifndef SOIL_CLI_H__
#define SOIL_CLI_H__

#include "soil.h"
#include <zephyr/bluetooth/mesh/access.h>

struct bt_mesh_soil_cli;

#define BT_MESH_SOIL_CLI_INIT(_handlers)		\
{												\
	.handlers = _handlers,						\
}

/** Bluetooth Mesh Soil Server model handlers. */
struct bt_mesh_soil_cli_handlers {
	/** @brief Handler for a report message. 
	 *
	 * @param[in] cli Soil Server that received the report message.
	 */
	void (*const report) (struct bt_mesh_soil_cli *cli, struct bt_mesh_msg_ctx *ctx, struct bt_mesh_soil_report soil);
};

#define BT_MESH_MODEL_SOIL_CLI(_cli)			    					\
		BT_MESH_MODEL_VND_CB(CONFIG_BT_COMPANY_ID,  					\
			SOIL_CLI_MODEL_ID,                      					\
			_bt_mesh_soil_cli_op, NULL,       							\
			BT_MESH_MODEL_USER_DATA(struct bt_mesh_soil_cli, _cli),     \
			&_bt_mesh_soil_cli_cb)


struct bt_mesh_soil_cli {
    /** Application handler functions. */
	const struct bt_mesh_soil_cli_handlers * handlers;
	/** Model entry. */
	struct bt_mesh_model *model;
	/** Publish parameters. */
	struct bt_mesh_model_pub pub;
	/* Publication buffer */
	struct net_buf_simple pub_msg;
	/* Publication data */
	uint8_t buf[BT_MESH_MODEL_BUF_LEN(BT_MESH_SOIL_OP_SOIL_REPORT, BT_MESH_LEN_EXACT(3))];
	/** Transaction ID tracker for the set messages. */
	struct bt_mesh_tid_ctx prev_transaction;
};

extern const struct bt_mesh_model_op _bt_mesh_soil_cli_op[];
extern const struct bt_mesh_model_cb _bt_mesh_soil_cli_cb;

#endif
```

## src/model_handler.c
```c
#include <zephyr/bluetooth/bluetooth.h>
#include <bluetooth/mesh/models.h>
#include <dk_buttons_and_leds.h>
#include "model_handler.h"
#include "soil_cli.h"

#define GET_DATA_INTERVAL 3000

// static struct k_work_delayable get_data_work;

// static void get_data(struct k_work *work)
// {
// 	if (!bt_mesh_is_provisioned()) {
// 		k_work_schedule(&get_data_work, K_MSEC(GET_DATA_INTERVAL));
// 		return;
// 	}

// 	int err;

// 	err = bt_mesh_sensor_cli_get(&sensor_cli, NULL, &bt_mesh_sensor_present_amb_rel_humidity, NULL);
// 	if (err) {
// 		printk("Error getting soil humidity (%d)\n", err);
// 	}

// 	k_work_schedule(&get_data_work, K_MSEC(GET_DATA_INTERVAL));
// }

static void health_current_status(struct bt_mesh_health_cli *cli, uint16_t addr,
				  uint8_t test_id, uint16_t cid, uint8_t *faults,
				  size_t fault_count)
{
	size_t i;

	printk("Health Current Status from 0x%04x\n", addr);

	if (!fault_count) {
		printk("Health Test ID 0x%02x Company ID 0x%04x: no faults\n",
		       test_id, cid);
		return;
	}

	printk("Health Test ID 0x%02x Company ID 0x%04x Fault Count %zu:\n",
	       test_id, cid, fault_count);

	for (i = 0; i < fault_count; i++) {
		printk("\t0x%02x\n", faults[i]);
	}
}

static struct bt_mesh_health_cli health_cli = {
	.current_status = health_current_status,
};


static struct bt_mesh_cfg_cli cfg_cli = {
};

void handle_soil_report(struct bt_mesh_soil_cli *cli, struct bt_mesh_msg_ctx *ctx, struct bt_mesh_soil_report soil)
{
	printk("Data: %d, %d, %d\n", soil.humidity, soil.temperature, ctx->addr);
	// printk("Data: %d, %d\n", soil.humidity, soil.temperature);

}

static const struct bt_mesh_soil_cli_handlers soil_cb = {
	.report = handle_soil_report
};

struct bt_mesh_soil_cli soil_cli = BT_MESH_SOIL_CLI_INIT(&soil_cb);

static struct bt_mesh_elem elements[] = {
	BT_MESH_ELEM(0,
		BT_MESH_MODEL_LIST(
			BT_MESH_MODEL_CFG_SRV,
			BT_MESH_MODEL_CFG_CLI(&cfg_cli),
			BT_MESH_MODEL_HEALTH_CLI(&health_cli)
		),
		BT_MESH_MODEL_LIST(
			BT_MESH_MODEL_SOIL_CLI(&soil_cli)
		)
	),
};

static const struct bt_mesh_comp comp = {
	.cid = CONFIG_BT_COMPANY_ID,
	.elem = elements,
	.elem_count = ARRAY_SIZE(elements),
};

const struct bt_mesh_comp *model_handler_init(void)
{
	// k_work_init_delayable(&get_data_work, get_data);
	
	// k_work_schedule(&get_data_work, K_MSEC(GET_DATA_INTERVAL));

	return &comp;
}
```

## src/soil_cli.c
```c
#include <zephyr/bluetooth/mesh.h>
#include "soil_cli.h"
#include "mesh/net.h"

static int handle_message_report(struct bt_mesh_model *model, struct bt_mesh_msg_ctx *ctx, struct net_buf_simple *buf)
{
	printk("handle_message_report\n");

	struct bt_mesh_soil_cli *cli = model->user_data;
	struct bt_mesh_soil_report soil;
	soil.humidity = net_buf_simple_pull_le16(buf);
	soil.temperature = net_buf_simple_pull_u8(buf);

	if (cli->handlers->report) {
		cli->handlers->report(cli, ctx, soil);
	}

	return 0;
}

const struct bt_mesh_model_op _bt_mesh_soil_cli_op[] = {
	{
		BT_MESH_SOIL_OP_SOIL_REPORT, BT_MESH_LEN_EXACT(3), handle_message_report
	},
	BT_MESH_MODEL_OP_END,
};

static int bt_mesh_soil_cli_init(struct bt_mesh_model *model)
{
	printk("bt_mesh_soil_cli_init\n");
	struct bt_mesh_soil_cli *cli = model->user_data;

	cli->model = model;

	net_buf_simple_init_with_data(&cli->pub_msg, cli->buf, sizeof(cli->buf));

	cli->pub.msg = &cli->pub_msg;

	return 0;
}

const struct bt_mesh_model_cb _bt_mesh_soil_cli_cb = {
	.init = bt_mesh_soil_cli_init,
};
```
