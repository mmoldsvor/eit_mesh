## CMakeLists.txt
```
cmake_minimum_required(VERSION 3.20.0)

find_package(Zephyr REQUIRED HINTS $ENV{ZEPHYR_BASE})
project(mesh_soil_sensor)

target_sources(app PRIVATE
	src/main.c
	src/model_handler.c
	src/soil_srv.c)
target_include_directories(app PRIVATE include)
```

## prj.conf
```kconfig
#
# Copyright (c) 2019 Nordic Semiconductor ASA
#
# SPDX-License-Identifier: LicenseRef-Nordic-5-Clause
#
CONFIG_NCS_SAMPLES_DEFAULTS=y

# Deffered logging helps improve LPN power consumption
# when friendship is established.
CONFIG_LOG_MODE_DEFERRED=y

# General configuration
CONFIG_MAIN_STACK_SIZE=4096
CONFIG_SYSTEM_WORKQUEUE_STACK_SIZE=4096
CONFIG_FLASH=y
CONFIG_FLASH_MAP=y
CONFIG_NVS=y
CONFIG_SETTINGS=y
CONFIG_HWINFO=y
CONFIG_DK_LIBRARY=y
CONFIG_PM_SINGLE_IMAGE=y
CONFIG_PM_PARTITION_SIZE_SETTINGS_STORAGE=0x8000
CONFIG_SOC_FLASH_NRF_PARTIAL_ERASE=y

# Bluetooth configuration
CONFIG_BT=y
CONFIG_BT_COMPANY_ID=0x0059
CONFIG_BT_DEVICE_NAME="Mesh Soil Sensor"
CONFIG_BT_L2CAP_TX_BUF_COUNT=32
CONFIG_BT_OBSERVER=y
CONFIG_BT_PERIPHERAL=y
CONFIG_BT_SETTINGS=y
CONFIG_BT_RX_STACK_SIZE=2400

# Disable unused Bluetooth features
CONFIG_BT_CTLR_DUP_FILTER_LEN=0
CONFIG_BT_CTLR_LE_ENC=n
CONFIG_BT_DATA_LEN_UPDATE=n
CONFIG_BT_PHY_UPDATE=n
CONFIG_BT_CTLR_CHAN_SEL_2=n
CONFIG_BT_CTLR_MIN_USED_CHAN=n
CONFIG_BT_CTLR_PRIVACY=n

# Bluetooth mesh configuration
CONFIG_BT_MESH=y
CONFIG_BT_MESH_RELAY=y
CONFIG_BT_MESH_FRIEND=y
CONFIG_BT_MESH_ADV_BUF_COUNT=64
CONFIG_BT_MESH_TX_SEG_MAX=32
CONFIG_BT_MESH_PB_GATT=y
CONFIG_BT_MESH_GATT_PROXY=y
CONFIG_BT_MESH_PROXY_USE_DEVICE_NAME=y
CONFIG_BT_MESH_DK_PROV=y

# Bluetooth mesh models
CONFIG_BT_MESH_SENSOR_SRV=y

# ADC
CONFIG_ADC=y
```

## overlay-lpn.conf
```kconfig
#
# Copyright (c) 2022 Nordic Semiconductor ASA
#
# SPDX-License-Identifier: LicenseRef-Nordic-5-Clause
#

CONFIG_BT_MESH_LOW_POWER=y
CONFIG_BT_DEVICE_NAME="Mesh Soil Sensor LPN"
CONFIG_BT_MESH_RELAY=n
CONFIG_BT_MESH_FRIEND=n

# Power saving configuration:

# Serial communication consumes considerable power
CONFIG_SERIAL=n
CONFIG_UART_CONSOLE=n

# While enabled, secure beacons will be advertised periodically.
# This consumes power, and is not required for an LPN node.
CONFIG_BT_MESH_BEACON_ENABLED=n

# Each LPN poll event consumes power. Extending the interval between poll events will improve power consumption
CONFIG_BT_MESH_LPN_POLL_TIMEOUT=600

# While GATT proxy is enabled, it will periodically advertise the network id.
# Disabling it will conserve energy.
CONFIG_BT_MESH_GATT_PROXY_ENABLED=n

# Reducing the node id advertisement timeout decreases the period where the device consumes power for advertising.
CONFIG_BT_MESH_NODE_ID_TIMEOUT=30
```

## boards/nrf52840dk_nrf52840.overlay
```dts
/*
 * SPDX-License-Identifier: Apache-2.0
 *
 * Copyright (c) 2022 Nordic Semiconductor ASA
 */


/ {
	zephyr,user {
		io-channels = <&adc 0>;
	};
};

&adc {
	#address-cells = <1>;
	#size-cells = <0>;

	channel@0 {
		reg = <0>;
		zephyr,gain = "ADC_GAIN_1_4";
		zephyr,reference = "ADC_REF_VDD_1_4";
		zephyr,acquisition-time = <ADC_ACQ_TIME_DEFAULT>;
		zephyr,input-positive = <NRF_SAADC_AIN1>; /* P0.03 */
		zephyr,resolution = <12>;
	};

};
```

## src/main.c
```c
#include <zephyr/bluetooth/bluetooth.h>
#include <bluetooth/mesh/models.h>
#include <bluetooth/mesh/dk_prov.h>
#include <dk_buttons_and_leds.h>
#include "model_handler.h"
#include <zephyr/kernel.h>
#include <zephyr/device.h>
#include <zephyr/devicetree.h>
#include <zephyr/drivers/adc.h>

#include "soil_srv.h"
#include "soil.h"


#if !DT_NODE_EXISTS(DT_PATH(zephyr_user)) || \
	!DT_NODE_HAS_PROP(DT_PATH(zephyr_user), io_channels)
#error "No suitable devicetree overlay specified"
#endif

#define DT_SPEC_AND_COMMA(node_id, prop, idx) \
	ADC_DT_SPEC_GET_BY_IDX(node_id, idx),

/* Data of ADC io-channels specified in devicetree. */
static const struct adc_dt_spec adc_channels[] = {
	DT_FOREACH_PROP_ELEM(DT_PATH(zephyr_user), io_channels,
			     DT_SPEC_AND_COMMA)
};


static void configure_node() {
	printk("Configure node\n");
}


static void prov_complete(uint16_t net_idx, uint16_t addr)
{
	configure_node();
	printk("Provisioning complete\n");
}

static void prov_reset(void)
{
	bt_mesh_prov_enable(BT_MESH_PROV_ADV | BT_MESH_PROV_GATT);
}

static uint8_t dev_uuid[16];

static const struct bt_mesh_prov prov = {
	.uuid = dev_uuid,
	.output_actions = BT_MESH_NO_OUTPUT,
	.complete = prov_complete,
	.reset = prov_reset,
};

static void bt_ready(int err)
{
	if (err) {
		printk("Bluetooth init failed (err %d)\n", err);
		return;
	}

	printk("Bluetooth initialized\n");

	dk_leds_init();
	dk_buttons_init(NULL);

	err = bt_mesh_init(&prov, model_handler_init());
	// err = bt_mesh_init(bt_mesh_dk_prov_init(), model_handler_init());
	if (err) {
		printk("Initializing mesh failed (err %d)\n", err);
		return;
	}

	if (IS_ENABLED(CONFIG_BT_MESH_LOW_POWER)) {
		bt_mesh_lpn_set(true);
	}

	if (IS_ENABLED(CONFIG_SETTINGS)) {
		settings_load();
	}

	/* This will be a no-op if settings_load() loaded provisioning info */
	bt_mesh_prov_enable(BT_MESH_PROV_ADV | BT_MESH_PROV_GATT);

	printk("Mesh initialized\n");
}


void my_work_handler(struct k_work *work)
{
	int16_t buf;
	int err;
	struct bt_mesh_soil_report soil;

	struct adc_sequence sequence = {
		.buffer = &buf,
		/* buffer size in bytes, not number of samples */
		.buffer_size = sizeof(buf),
	};

    printk("ADC reading:\n");
	for (size_t i = 0U; i < ARRAY_SIZE(adc_channels); i++) {
			// int32_t val_mv;

		printk("- %s, channel %d: ",
		       adc_channels[i].dev->name,
		       adc_channels[i].channel_id);

		(void)adc_sequence_init_dt(&adc_channels[i], &sequence);

		err = adc_read(adc_channels[i].dev, &sequence);
		if (err < 0) {
			printk("Could not read (%d)\n", err);
			continue;
		} else {
			printk("%d\n", buf);
			soil.humidity = buf;
			soil.temperature = 0;
		}

		soil_report(soil);

	}
}

K_WORK_DEFINE(adc_work, my_work_handler);

void my_timer_handler(struct k_timer *dummy)
{
    k_work_submit(&adc_work);
}

K_TIMER_DEFINE(my_timer, my_timer_handler, NULL);

/* start periodic timer that expires once every second */


void main(void)
{
	k_timer_start(&my_timer, K_SECONDS(1), K_SECONDS(1));

	int err;
	

	/* Configure channels individually prior to sampling. */
	for (size_t i = 0U; i < ARRAY_SIZE(adc_channels); i++) {
		if (!device_is_ready(adc_channels[i].dev)) {
			printk("ADC controller device not ready\n");
			return;
		}

		err = adc_channel_setup_dt(&adc_channels[i]);
		if (err < 0) {
			printk("Could not setup channel #%d (%d)\n", i, err);
			return;
		}
	}

	printk("Initializing...\n");

	err = bt_enable(bt_ready);
	if (err) {
		printk("Bluetooth init failed (err %d)\n", err);
	}
}
```

## include/model_handler.h
```c
#ifndef MODEL_HANDLER_H__
#define MODEL_HANDLER_H__

#include <zephyr/bluetooth/mesh.h>
#include "soil.h"

const struct bt_mesh_comp *model_handler_init(void);

void soil_report(struct bt_mesh_soil_report soil);

#endif
```

## include/soil.h
```c
#ifndef BT_MESH_SOIL_H__
#define BT_MESH_SOIL_H__

#include <zephyr/bluetooth/mesh.h>
#include <bluetooth/mesh/model_types.h>

#define SOIL_CLI_MODEL_ID 0x0011
#define SOIL_SRV_MODEL_ID 0x0012

/** Soil set message parameters.  */
struct bt_mesh_soil_report {
	uint16_t humidity;
    uint8_t temperature;
};

#define BT_MESH_SOIL_OP_SOIL_REPORT BT_MESH_MODEL_OP_3(0x11, CONFIG_BT_COMPANY_ID)

#endif
```

## include/soil_srv.h
```c
#ifndef SOIL_SRV_H__
#define SOIL_SRV_H__

#include "soil.h"
#include <zephyr/bluetooth/mesh/access.h>

struct bt_mesh_soil_srv;

#define BT_MESH_MODEL_SOIL_SRV(_srv)			    \
		BT_MESH_MODEL_VND_CB(CONFIG_BT_COMPANY_ID,  \
			SOIL_SRV_MODEL_ID,                      \
			BT_MESH_MODEL_NO_OPS, &(_srv)->pub,     \
			BT_MESH_MODEL_USER_DATA(				\
				struct bt_mesh_soil_srv, _srv),     \
			&_bt_mesh_soil_srv_cb)
		

struct bt_mesh_soil_srv {
    /** Application handler functions. */
	const struct bt_mesh_soil_srv_handlers * handlers;
	/** Model entry. */
	struct bt_mesh_model *model;
	/** Publish parameters. */
	struct bt_mesh_model_pub pub;
	/* Publication buffer */
	struct net_buf_simple pub_msg;
	/* Publication data */
	uint16_t buf[BT_MESH_MODEL_BUF_LEN(BT_MESH_SOIL_OP_SOIL_REPORT, BT_MESH_LEN_EXACT(3))];
	/** Transaction ID tracker for the set messages. */
	struct bt_mesh_tid_ctx prev_transaction;
};

int bt_mesh_soil_srv_report(struct bt_mesh_soil_srv *srv, struct bt_mesh_soil_report soil);


// extern const struct bt_mesh_model_op _bt_mesh_soil_srv_op[];
extern const struct bt_mesh_model_cb _bt_mesh_soil_srv_cb;


#endif
```

## src/model_handler.c
```c
#include <zephyr/bluetooth/bluetooth.h>
#include <zephyr/bluetooth/mesh/proxy.h>
#include <bluetooth/mesh/models.h>
#include <bluetooth/mesh/sensor_types.h>
#include <dk_buttons_and_leds.h>
#include "model_handler.h"
#include "soil_srv.h"

/* Set up a repeating delayed work to blink the DK's LEDs when attention is
 * requested.
 */
static struct k_work_delayable attention_blink_work;
static bool attention;

static void attention_blink(struct k_work *work)
{
	static int idx;
	const uint8_t pattern[] = {
#if DT_NODE_EXISTS(DT_ALIAS(sw0))
		BIT(0),
#endif
#if DT_NODE_EXISTS(DT_ALIAS(sw1))
		BIT(1),
#endif
#if DT_NODE_EXISTS(DT_ALIAS(sw2))
		BIT(2),
#endif
#if DT_NODE_EXISTS(DT_ALIAS(sw3))
		BIT(3),
#endif
	};

	if (attention) {
		dk_set_leds(pattern[idx++ % ARRAY_SIZE(pattern)]);
		k_work_reschedule(&attention_blink_work, K_MSEC(30));
	} else {
		dk_set_leds(DK_NO_LEDS_MSK);
	}
}

static void attention_on(struct bt_mesh_model *mod)
{
	attention = true;
	k_work_reschedule(&attention_blink_work, K_NO_WAIT);
}

static void attention_off(struct bt_mesh_model *mod)
{
	/* Will stop rescheduling blink timer */
	attention = false;
}

static const struct bt_mesh_health_srv_cb health_srv_cb = {
	.attn_on = attention_on,
	.attn_off = attention_off,
};

static struct bt_mesh_health_srv health_srv = {
	.cb = &health_srv_cb,
};

BT_MESH_HEALTH_PUB_DEFINE(health_pub, 0);

/* Soil sensor */

static struct bt_mesh_soil_srv soil_srv;

static struct bt_mesh_elem elements[] = {
	BT_MESH_ELEM(0,
		BT_MESH_MODEL_LIST(
			BT_MESH_MODEL_CFG_SRV,
			BT_MESH_MODEL_HEALTH_SRV(&health_srv, &health_pub)
		),
		BT_MESH_MODEL_LIST(
			BT_MESH_MODEL_SOIL_SRV(&soil_srv)
		)
	),
};

static const struct bt_mesh_comp comp = {
	.cid = CONFIG_BT_COMPANY_ID,
	.elem = elements,
	.elem_count = ARRAY_SIZE(elements),
};

const struct bt_mesh_comp *model_handler_init(void)
{
	k_work_init_delayable(&attention_blink_work, attention_blink);

	return &comp;
}

void soil_report(struct bt_mesh_soil_report soil)
{
	bt_mesh_soil_srv_report(&soil_srv, soil);
}
```

## src/soil_srv.c
```c
#include <zephyr/bluetooth/mesh.h>
#include "mesh/net.h"
#include "soil_srv.h"

#include <zephyr/kernel.h>
#include <zephyr/device.h>
#include <zephyr/devicetree.h>
#include <zephyr/drivers/adc.h>


int bt_mesh_soil_srv_report(struct bt_mesh_soil_srv *srv, struct bt_mesh_soil_report soil)
{
    printk("bt_mesh_soil_srv_report\n");
    bt_mesh_model_msg_init(&srv->pub_msg, BT_MESH_SOIL_OP_SOIL_REPORT);
	net_buf_simple_add_mem(&srv->pub_msg, &soil.humidity, sizeof(soil.humidity));
	net_buf_simple_add_mem(&srv->pub_msg, &soil.temperature, sizeof(soil.temperature));

    return bt_mesh_model_publish(srv->model);
}

static int bt_mesh_soil_srv_update(struct bt_mesh_model *model)
{
	struct bt_mesh_soil_srv *soil = model->user_data;
    printk("bt_mesh_soil_srv_update\n");
    // bt_mesh_model_msg_init(model->pub->msg, BT_MESH_SOIL_OP_SOIL_REPORT);
	// net_buf_simple_add_u8(model->pub->msg, 1);
	// net_buf_simple_add_u8(model->pub->msg, 2);

    return 0;
}

static int bt_mesh_soil_srv_init(struct bt_mesh_model *model)
{
	struct bt_mesh_soil_srv *srv = model->user_data;

	srv->model = model;

	net_buf_simple_init_with_data(&srv->pub_msg, srv->buf, sizeof(srv->buf));
	
    srv->pub.msg = &srv->pub_msg;
    srv->pub.update = bt_mesh_soil_srv_update;

	printk("Init Soil Model\n");
	return 0;
}

const struct bt_mesh_model_cb _bt_mesh_soil_srv_cb = {
	.init = bt_mesh_soil_srv_init,
};
```
